## config/west.yml
```yaml
manifest:
  remotes:
    - name: zmkfirmware
      url-base: https://github.com/zmkfirmware
  projects:
    # Standalone: the eyelash_corne board and the nice_view_gem shield (with the
    # hummingbird animation) are vendored in this repo under boards/, discoverable
    # via zephyr/module.yml (board_root: .). Only ZMK itself is pulled, pinned to a
    # tag, so nothing external can change out from under the build.
    - name: zmk
      remote: zmkfirmware
      revision: v0.3
      import: app/west.yml
  self:
    path: config
```
